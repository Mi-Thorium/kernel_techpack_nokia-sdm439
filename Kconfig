## Kconfig
```kconfig
menu "Nokia SDM439 platform"
	depends on ARCH_SDM439

config MACH_NOKIA_SDM439
	bool "Support for Nokia SDM439 platform"
	help
	  Say Y here to enable support for Nokia SDM439 platform.

if MACH_NOKIA_SDM439

source "techpack/nokia-sdm439/mach/Kconfig"

source "techpack/nokia-sdm439/fingerprint/Kconfig"
source "techpack/nokia-sdm439/touchscreen/Kconfig"

endif # MACH_NOKIA_SDM439

endmenu
```

## fingerprint/Kconfig
```kconfig
menu "Fingerprint"

source "techpack/nokia-sdm439/fingerprint/chipone/Kconfig"
source "techpack/nokia-sdm439/fingerprint/sunwave/Kconfig"

endmenu
```

## fingerprint/chipone/Kconfig
```kconfig
config CHIPONE_FINGERPRINT_NOKIA439
	tristate "Chipone Finger Print Driver"
	help
	  Chipone Finger Print Supported
```

## fingerprint/sunwave/Kconfig
```kconfig
config SUNWAVE_FINGERPRINT_NOKIA439
	tristate "Sunwave Fingerprint"
	help
	  SUNWAVECORP Fingerprint
```

## mach/Kconfig
```kconfig
menu "Machine selection"

config MACH_NOKIA_DEADPOOL
	bool "Nokia 3.2 (Deadpool)"
	depends on ARCH_SDM429
	help
	  Nokia 3.2 (Deadpool)

config MACH_NOKIA_PANTHER
	bool "Nokia 4.2 (Panther)"
	depends on ARCH_SDM439
	help
	  Nokia 4.2 (Panther)

endmenu
```

## touchscreen/Kconfig
```kconfig
menu "Touchscreen"
	depends on INPUT_TOUCHSCREEN

source "techpack/nokia-sdm439/touchscreen/focaltech_touch/Kconfig"
source "techpack/nokia-sdm439/touchscreen/gt9xx/Kconfig"
source "techpack/nokia-sdm439/touchscreen/hxchipset/Kconfig"

config TOUCHSCREEN_SINTRONIX_TS
        bool "TOUCHSCREEN_SINTRONIX_TS"
        depends on I2C
        help
          Say Y here if you have a TOUCHSCREEN_SINTRONIX_TS touchscreen.
          Gt9xx controllers are multi touch controllers which can
          report 5 touches at a time.

          If unsure, say N.

endmenu
```

## touchscreen/focaltech_touch/Kconfig
```kconfig
#
# Focaltech Touchscreen driver configuration
#

config TOUCHSCREEN_FTS_NOKIA439
    bool "Focaltech Touchscreen"
    depends on I2C
    default n
    help
      Say Y here if you have Focaltech touch panel.
      If unsure, say N.
      
config TOUCHSCREEN_FTS_DIRECTORY_NOKIA439
    string "Focaltech ts directory name"
    default "focaltech_touch"
    depends on TOUCHSCREEN_FTS_NOKIA439
```

## touchscreen/hxchipset/Kconfig
```kconfig
#
# Himax Touchscreen driver configuration
#

config TOUCHSCREEN_HIMAX_I2C_NOKIA439
        tristate "HIMAX chipset i2c touchscreen"
	help
	  This enables support for HIMAX CHIPSET over I2C based touchscreens.

config TOUCHSCREEN_HIMAX_DEBUG_NOKIA439
        tristate "HIMAX debug function"
	depends on TOUCHSCREEN_HIMAX_I2C_NOKIA439
	help
	  This enables support for HIMAX debug function.

config TOUCHSCREEN_HIMAX_ITO_TEST_NOKIA439
	tristate "HIMAX driver test over Dragon Board"
	depends on TOUCHSCREEN_HIMAX_I2C_NOKIA439
	help
	  This enables support for HIMAX driver test over Dragon Board.

config HMX_DB_NOKIA439
	tristate "HIMAX driver test over Dragon Board"
	depends on TOUCHSCREEN_HIMAX_I2C_NOKIA439
	help
	  This enables support for HIMAX driver test over Dragon Board.
```
